## config/boards/shields/formatrix/Kconfig.defconfig
```kconfig
# FORM.MATRIX - Default Configuration
# Copyright (c) 2026 FORM LABS
# SPDX-License-Identifier: MIT

if SHIELD_FORMATRIX_LEFT

config ZMK_KEYBOARD_NAME
    default "FORM.MATRIX"

config ZMK_BLE_PASSKEY_ENTRY
    default y

endif

if SHIELD_FORMATRIX_RIGHT

config ZMK_KEYBOARD_NAME
    default "FORM.MATRIX"

endif
```

## config/boards/shields/formatrix/Kconfig.shield
```kconfig
# FORM.MATRIX - Split Wireless Keyboard
# Copyright (c) 2026 FORM LABS
# SPDX-License-Identifier: MIT

config SHIELD_FORMATRIX
    def_bool $(shields_list_contains,formatrix)

config SHIELD_FORMATRIX_LEFT
    def_bool $(shields_list_contains,formatrix_left)

config SHIELD_FORMATRIX_RIGHT
    def_bool $(shields_list_contains,formatrix_right)
```

## config/west.yml
```yaml
# FORM.MATRIX - West Manifest
# Copyright (c) 2026 FORM LABS

manifest:
  remotes:
    - name: zmkfirmware
      url-base: https://github.com/zmkfirmware
  projects:
    - name: zmk
      remote: zmkfirmware
      revision: main
      import: app/west.yml
  self:
    path: config
```
